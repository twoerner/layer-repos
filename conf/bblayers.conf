## conf/bblayers.conf
```bitbake
# LAYER_CONF_VERSION is increased each time build/conf/bblayers.conf
# changes incompatibly
LCONF_VERSION = "6"

BBPATH = "${TOPDIR}"
BBFILES ?= ""

BBLAYERS = " \
	##OEROOT##/layers/openembedded-core/meta \
	\
	##OEROOT##/layers/meta-openembedded/meta-oe \
	##OEROOT##/layers/meta-openembedded/meta-initramfs \
	##OEROOT##/layers/meta-openembedded/meta-networking \
	##OEROOT##/layers/meta-openembedded/meta-webserver \
	##OEROOT##/layers/meta-openembedded/meta-python \
	##OEROOT##/layers/meta-openembedded/meta-ruby \
	##OEROOT##/layers/meta-openembedded/meta-systemd \
	##OEROOT##/layers/meta-openembedded/meta-efl \
	##OEROOT##/layers/meta-openembedded/meta-filesystems \
	##OEROOT##/layers/meta-openembedded/meta-gnome \
	##OEROOT##/layers/meta-openembedded/meta-gpe \
	##OEROOT##/layers/meta-openembedded/meta-multimedia \
	##OEROOT##/layers/meta-openembedded/meta-perl \
	##OEROOT##/layers/meta-openembedded/meta-xfce \
	\
	##OEROOT##/layers/meta-chip \
	##OEROOT##/layers/meta-sunxi \
	##OEROOT##/layers/meta-qcom \
	##OEROOT##/layers/meta-rockchip \
	##OEROOT##/layers/meta-96boards \
	##OEROOT##/layers/meta-fsl-arm \
	##OEROOT##/layers/meta-intel \
	##OEROOT##/layers/meta-raspberrypi \
	\
	##OEROOT##/layers/meta-linaro/meta-linaro \
	##OEROOT##/layers/meta-linaro/meta-linaro-toolchain \
	##OEROOT##/layers/meta-linaro/meta-aarch64 \
	##OEROOT##/layers/meta-qt5 \
	##OEROOT##/layers/meta-realtime \
	##OEROOT##/layers/meta-fullrt \
	\
	##OEROOT##/layers/meta-poky/meta-poky \
	##OEROOT##/layers/meta-angstrom \
	"
```
